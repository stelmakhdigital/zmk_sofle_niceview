/ {
    &i2c1 {
        status = "okay";
        sda-pin = <2>;
        scl-pin = <3>;

        iqs5xx: iqs5xx@74 {
            compatible = "azoteq,iqs5xx";
            reg = <0x74>;
            // same pin like niceview
            dr-gpios = <&gpio0 7 GPIO_ACTIVE_LOW>;
            x-invert = <false>;
            y-invert = <false>;
            no-taps = <false>;
        };
    };
};
