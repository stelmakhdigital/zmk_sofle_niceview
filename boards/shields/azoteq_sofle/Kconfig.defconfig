## boards/shields/azoteq_sofle/Kconfig.defconfig
```kconfig
if SHIELD_AZOTEQ_SOFLE_LEFT || SHIELD_AZOTEQ_SOFLE_RIGHT

config ZMK_KEYBOARD_NAME
    default "Stelmakh"

config ZMK_BLE
    default y

config ZMK_SPLIT_BLE_CENTRAL_PERIPHERALS
    default 2

config BT_MAX_CONN
    default 5

config BT_MAX_PAIRED
    default 5

config ZMK_STUDIO
    default n

config ZMK_STUDIO_LOCKING
    default n  

config ZMK_SLEEP
    default y

config I2C
    default y

config ZMK_RGB_UNDERGLOW
    default y

config ZMK_RGB_UNDERGLOW_EXT_POWER
    default n

config ZMK_RGB_UNDERGLOW_AUTO_OFF_IDLE
    default y

if ZMK_RGB_UNDERGLOW

config WS2812_STRIP
    default y

endif ## ZMK_RGB_UNDERGLOW

endif ## SHIELD_SOFLE_LEFT || SHIELD_SOFLE_RIGHT



if SHIELD_AZOTEQ_SOFLE_RIGHT

config ZMK_SPLIT_ROLE_CENTRAL
    default n

endif ## SHIELD_AZOTEQ_SOFLE_RIGHT



if SHIELD_AZOTEQ_SOFLE_LEFT

config ZMK_SPLIT_ROLE_CENTRAL
    default y

endif ## SHIELD_AZOTEQ_SOFLE_LEFT
```

## boards/shields/display_view/Kconfig.shield
```kconfig
# Copyright (c) 2022 The ZMK Contributors
# SPDX-License-Identifier: MIT

config SHIELD_DISPLAY_VIEW_PRO_MICRO
    def_bool $(shields_list_contains,display_view_pro_micro)
```

## boards/shields/sofle/Kconfig.defconfig
```kconfig
if SHIELD_SOFLE_LEFT || SHIELD_SOFLE_RIGHT

config ZMK_KEYBOARD_NAME
    default "Stelmakh"

config ZMK_SPLIT
    default y

config ZMK_SPLIT_ROLE_CENTRAL
    default y

config ZMK_SPLIT_BLE_CENTRAL_PERIPHERALS
    default 2

config ZMK_BLE
    default y

config BT_MAX_CONN
    default 5

config BT_MAX_PAIRED
    default 5

config ZMK_STUDIO
    default y

config ZMK_STUDIO_LOCKING
    default n  

config ZMK_SLEEP
    default n
    
config I2C
    default n

config ZMK_DISPLAY
    default y

if ZMK_DISPLAY

config SSD1306
    default y

endif ## ZMK_DISPLAY


if LVGL

config LV_Z_VDB_SIZE
    default 64

config LV_DPI_DEF
    default 148

config LV_Z_BITS_PER_PIXEL
    default 1

choice LV_COLOR_DEPTH
    default LV_COLOR_DEPTH_1
endchoice

endif ## LVGL


config ZMK_RGB_UNDERGLOW
    default y

config ZMK_RGB_UNDERGLOW_EXT_POWER
    default n

config ZMK_RGB_UNDERGLOW_AUTO_OFF_IDLE
    default y

if ZMK_RGB_UNDERGLOW

config WS2812_STRIP
    default y

endif ## ZMK_RGB_UNDERGLOW


endif ## SHIELD_SOFLE_LEFT || SHIELD_SOFLE_RIGHT



if SHIELD_SOFLE_RIGHT

config ZMK_SPLIT_ROLE_CENTRAL
    default n

endif ## SHIELD_SOFLE_RIGHT
```

## boards/shields/sofle_keyboard/Kconfig.shield
```kconfig
# No whitespace after the comma or in the keyboard name!
config SHIELD_SOFLE_KEYBOARD_DONGLE
    def_bool $(shields_list_contains,sofle_keyboard_dongle)
```

## build/Kconfig/Kconfig.modules
```kconfig
menu "zmk-driver-azoteq (/Users/budaev/Code/Home/zmk_sofle_niceview/zmk_driver_azoteq)"
osource "/Users/budaev/Code/Home/zmk_sofle_niceview/zmk_driver_azoteq/Kconfig"
config ZEPHYR_ZMK_DRIVER_AZOTEQ_MODULE
	bool
	default y
endmenu
menu "nanopb (/Users/budaev/Code/Home/zmk_sofle_niceview/modules/lib/nanopb)"
osource "$(ZEPHYR_NANOPB_KCONFIG)"
config ZEPHYR_NANOPB_MODULE
	bool
	default y
endmenu
menu "acpica (/Users/budaev/Code/Home/zmk_sofle_niceview/modules/lib/acpica)"
osource "$(ZEPHYR_ACPICA_KCONFIG)"
config ZEPHYR_ACPICA_MODULE
	bool
	default y
endmenu
menu "canopennode (/Users/budaev/Code/Home/zmk_sofle_niceview/modules/lib/canopennode)"
osource "$(ZEPHYR_CANOPENNODE_KCONFIG)"
config ZEPHYR_CANOPENNODE_MODULE
	bool
	default y
endmenu
menu "cmsis (/Users/budaev/Code/Home/zmk_sofle_niceview/modules/hal/cmsis)"
osource "$(ZEPHYR_CMSIS_KCONFIG)"
config ZEPHYR_CMSIS_MODULE
	bool
	default y
endmenu
menu "cmsis-dsp (/Users/budaev/Code/Home/zmk_sofle_niceview/modules/lib/cmsis-dsp)"
osource "$(ZEPHYR_CMSIS_DSP_KCONFIG)"
config ZEPHYR_CMSIS_DSP_MODULE
	bool
	default y
endmenu
menu "cmsis-nn (/Users/budaev/Code/Home/zmk_sofle_niceview/modules/lib/cmsis-nn)"
osource "$(ZEPHYR_CMSIS_NN_KCONFIG)"
config ZEPHYR_CMSIS_NN_MODULE
	bool
	default y
endmenu
menu "fatfs (/Users/budaev/Code/Home/zmk_sofle_niceview/modules/fs/fatfs)"
osource "$(ZEPHYR_FATFS_KCONFIG)"
config ZEPHYR_FATFS_MODULE
	bool
	default y
endmenu
menu "hal_ambiq (/Users/budaev/Code/Home/zmk_sofle_niceview/modules/hal/ambiq)"
osource "$(ZEPHYR_HAL_AMBIQ_KCONFIG)"
config ZEPHYR_HAL_AMBIQ_MODULE
	bool
	default y
endmenu
menu "hal_espressif (/Users/budaev/Code/Home/zmk_sofle_niceview/modules/hal/espressif)"
osource "/Users/budaev/Code/Home/zmk_sofle_niceview/modules/hal/espressif/zephyr/Kconfig"
config ZEPHYR_HAL_ESPRESSIF_MODULE
	bool
	default y
endmenu
menu "hal_ethos_u (/Users/budaev/Code/Home/zmk_sofle_niceview/modules/hal/ethos_u)"
osource "$(ZEPHYR_HAL_ETHOS_U_KCONFIG)"
config ZEPHYR_HAL_ETHOS_U_MODULE
	bool
	default y
endmenu
menu "hal_gigadevice (/Users/budaev/Code/Home/zmk_sofle_niceview/modules/hal/gigadevice)"
osource "$(ZEPHYR_HAL_GIGADEVICE_KCONFIG)"
config ZEPHYR_HAL_GIGADEVICE_MODULE
	bool
	default y
endmenu
menu "hal_nordic (/Users/budaev/Code/Home/zmk_sofle_niceview/modules/hal/nordic)"
osource "$(ZEPHYR_HAL_NORDIC_KCONFIG)"
config ZEPHYR_HAL_NORDIC_MODULE
	bool
	default y
endmenu
menu "hal_rpi_pico (/Users/budaev/Code/Home/zmk_sofle_niceview/modules/hal/rpi_pico)"
osource "$(ZEPHYR_HAL_RPI_PICO_KCONFIG)"
config ZEPHYR_HAL_RPI_PICO_MODULE
	bool
	default y
endmenu
menu "hal_telink (/Users/budaev/Code/Home/zmk_sofle_niceview/modules/hal/telink)"
osource "/Users/budaev/Code/Home/zmk_sofle_niceview/modules/hal/telink/Kconfig"
config ZEPHYR_HAL_TELINK_MODULE
	bool
	default y
endmenu
menu "liblc3 (/Users/budaev/Code/Home/zmk_sofle_niceview/modules/lib/liblc3)"
osource "$(ZEPHYR_LIBLC3_KCONFIG)"
config ZEPHYR_LIBLC3_MODULE
	bool
	default y
endmenu
menu "littlefs (/Users/budaev/Code/Home/zmk_sofle_niceview/modules/fs/littlefs)"
osource "$(ZEPHYR_LITTLEFS_KCONFIG)"
config ZEPHYR_LITTLEFS_MODULE
	bool
	default y
endmenu
menu "lvgl (/Users/budaev/Code/Home/zmk_sofle_niceview/modules/lib/gui/lvgl)"
osource "/Users/budaev/Code/Home/zmk_sofle_niceview/modules/lib/gui/lvgl/Kconfig"
config ZEPHYR_LVGL_MODULE
	bool
	default y
endmenu
menu "mbedtls (/Users/budaev/Code/Home/zmk_sofle_niceview/modules/crypto/mbedtls)"
osource "$(ZEPHYR_MBEDTLS_KCONFIG)"
config ZEPHYR_MBEDTLS_MODULE
	bool
	default y
endmenu
menu "percepio (/Users/budaev/Code/Home/zmk_sofle_niceview/modules/debug/percepio)"
osource "/Users/budaev/Code/Home/zmk_sofle_niceview/modules/debug/percepio/zephyr/Kconfig"
config ZEPHYR_PERCEPIO_MODULE
	bool
	default y
endmenu
menu "picolibc (/Users/budaev/Code/Home/zmk_sofle_niceview/modules/lib/picolibc)"
osource "/Users/budaev/Code/Home/zmk_sofle_niceview/modules/lib/picolibc/zephyr/Kconfig"
config ZEPHYR_PICOLIBC_MODULE
	bool
	default y
endmenu
menu "segger (/Users/budaev/Code/Home/zmk_sofle_niceview/modules/debug/segger)"
osource "$(ZEPHYR_SEGGER_KCONFIG)"
config ZEPHYR_SEGGER_MODULE
	bool
	default y
endmenu
menu "trusted-firmware-a (/Users/budaev/Code/Home/zmk_sofle_niceview/modules/tee/tf-a/trusted-firmware-a)"
osource "$(ZEPHYR_TRUSTED_FIRMWARE_A_KCONFIG)"
config ZEPHYR_TRUSTED_FIRMWARE_A_MODULE
	bool
	default y
endmenu
menu "uoscore-uedhoc (/Users/budaev/Code/Home/zmk_sofle_niceview/modules/lib/uoscore-uedhoc)"
osource "$(ZEPHYR_UOSCORE_UEDHOC_KCONFIG)"
config ZEPHYR_UOSCORE_UEDHOC_MODULE
	bool
	default y
endmenu
menu "zcbor (/Users/budaev/Code/Home/zmk_sofle_niceview/modules/lib/zcbor)"
osource "$(ZEPHYR_ZCBOR_KCONFIG)"
config ZEPHYR_ZCBOR_MODULE
	bool
	default y
endmenu
menu "module (/Users/budaev/Code/Home/zmk_sofle_niceview/zmk/app/module)"
osource "/Users/budaev/Code/Home/zmk_sofle_niceview/zmk/app/module/Kconfig"
config ZEPHYR_MODULE_MODULE
	bool
	default y
endmenu
```

## config/boards/shields/azoteq_sofle/Kconfig.shield
```kconfig
config SHIELD_AZOTEQ_SOFLE_LEFT
    def_bool $(shields_list_contains,azoteq_sofle_left)

config SHIELD_AZOTEQ_SOFLE_RIGHT
    def_bool $(shields_list_contains,azoteq_sofle_right)
```

## config/west.yml
```yaml
manifest:
  remotes:
    - name: zmkfirmware
      url-base: https://github.com/zmkfirmware
    - name: stelmakhdigital
      url-base: https://github.com/stelmakhdigital
  projects:
    - name: zmk
      remote: zmkfirmware
      revision: main
      import: app/west.yml
    - name: zmk_driver_azoteq
      remote: stelmakhdigital
      revision: master
    - name: zmk_niceview_horizontal
      remote: stelmakhdigital
      revision: master
    - name: zmk_azoteq_touchpad
      remote: stelmakhdigital
      revision: master
  self:
    path: config
```
